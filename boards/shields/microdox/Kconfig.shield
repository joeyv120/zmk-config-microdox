## boards/shields/microdox/Kconfig.shield
```kconfig
# No whitespace after the comma or in the keyboard name!
config SHIELD_MICRODOX_DONGLE
    def_bool $(shields_list_contains,microdox_dongle)
```

## config/west.yml
```yaml
manifest:
  remotes:
    - name: zmkfirmware
      url-base: https://github.com/zmkfirmware
  projects:
    - name: zmk
      remote: zmkfirmware
      revision: main
      import: app/west.yml
      revision: v0.3
  self:
    path: config
```
